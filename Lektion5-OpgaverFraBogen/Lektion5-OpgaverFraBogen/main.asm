;
; Lektion5-OpgaverFraBogen.asm
;
; Created: 20-03-2018 13:45:45
; Author : Sebastian
;

.INCLUDE "M32ADEF.INC"

.ORG 0x0000
			RJMP INI

.ORG 0x002A
INI:		
			;STACK POINTER
			LDI R16,HIGH(RAMEND)
			OUT SPH,R16
			LDI R16,LOW(RAMEND)
			OUT SPL,R16

			;PORTC SETUP
			LDI R16,0x00
			OUT DDRC,R16
			LDI R16,0xFF
			OUT PORTC,R16

			;PORTB SETUP
			OUT DDRB,R16
			OUT PORTB,R16

START:		
			IN R16,PINC ;8-BIT ITEM
			COM R16

			CALL HIGHFUNC

			RJMP START

HIGHFUNC:	;PROGRAM THAT FINDS THE FIRST HIGH IN AN 8-BIT ITEM:
			LDI R22,0x08 ;COUNTER TO FIND FIRST HIGH BIT
			LDI R23,0x08 ;MAXIMUM AMOUNT OF TIMES TO RUN THE LOOP

CALCHIGH:	ROL R16
			BRCS CARRY1
			DEC R22
			DEC R23
			BRNE CALCHIGH

CARRY1:		CPI R22,0x08
			BREQ NUM8

			CPI R22,0x07
			BREQ NUM7

			CPI R22,0x06
			BREQ NUM6

			CPI R22,0x05
			BREQ NUM5

			CPI R22,0x04
			BREQ NUM4

			CPI R22,0x03
			BREQ NUM3

			CPI R22,0x02
			BREQ NUM2

			CPI R22,0x01
			BREQ NUM1

			CPI R22,0x00
			BREQ NUM0	

NUM0:
			LDI R19,0xA0
			OUT PORTB, R19
			
			RJMP END1

NUM1:
			LDI R19,0xF3
			OUT PORTB, R19
			
			RJMP END1

NUM2:
			LDI R19,0x94
			OUT PORTB, R19
			
			RJMP END1

NUM3:
			LDI R19,0x91
			OUT PORTB, R19
			
			RJMP END1

NUM4:
			LDI R19,0xC3
			OUT PORTB, R19
			
			RJMP END1

NUM5:
			LDI R19,0x89
			OUT PORTB, R19
			
			RJMP END1

NUM6:
			LDI R19,0x88
			OUT PORTB, R19
			
			RJMP END1

NUM7:
			LDI R19,0xB3
			OUT PORTB, R19
			
			RJMP END1

NUM8:
			LDI R19,0x80
			OUT PORTB, R19

END1:		RET


CALLFUNC:	;PROGRAM THAT COUNTS NUMBER OF ZEROS IN AN 8-BIT ITEM:
			LDI R22,0x00 ;ZERO COUNTER
			LDI R23,0x08 ;AMOUNT OF TIMES TO RUN LOOP

CALC:		ROR R16
			BRCC CARRY0 ;IF CARRY IS 0, BRANCH TO CARRY0
			DEC R23
			BRNE CALC
			RJMP OUTPUT ;IF R23=0, FINISH CALCULATION

CARRY0:		INC R22
			DEC R23
			BRNE CALC

OUTPUT:		ROR R16 ;RETURN R16 TO ORIGINAL VALUE
			
			CPI R22,0x00
			BREQ COUNT0

			CPI R22,0x01
			BREQ COUNT1

			CPI R22,0x02
			BREQ COUNT2

			CPI R22,0x03
			BREQ COUNT3

			CPI R22,0x04
			BREQ COUNT4

			CPI R22,0x05
			BREQ COUNT5

			CPI R22,0x06
			BREQ COUNT6

			CPI R22,0x07
			BREQ COUNT7

			CPI R22,0x08
			BREQ COUNT8

COUNT0:
			LDI R19,0xA0
			OUT PORTB, R19
			
			RJMP END

COUNT1:
			LDI R19,0xF3
			OUT PORTB, R19
			
			RJMP END

COUNT2:
			LDI R19,0x94
			OUT PORTB, R19
			
			RJMP END

COUNT3:
			LDI R19,0x91
			OUT PORTB, R19
			
			RJMP END

COUNT4:
			LDI R19,0xC3
			OUT PORTB, R19
			
			RJMP END

COUNT5:
			LDI R19,0x89
			OUT PORTB, R19
			
			RJMP END

COUNT6:
			LDI R19,0x88
			OUT PORTB, R19
			
			RJMP END

COUNT7:
			LDI R19,0xB3
			OUT PORTB, R19
			
			RJMP END

COUNT8:
			LDI R19,0x80
			OUT PORTB, R19
			
END:		RET