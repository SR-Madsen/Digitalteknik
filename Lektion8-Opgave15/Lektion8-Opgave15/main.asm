;PROGRAM FOR MAKING HORIZONTAL LINES ON ATMEGA PRINT FLASH WITH 5 HZ, 2 HZ, AND 1 HZ (TOP, MIDDLE, AND BOTTOM RESPECTIVELY)

.INCLUDE "M32ADEF.INC"

.ORG 0x0000
			RJMP INI

.ORG 0x0014
			RJMP INT_0

.ORG 0x002A
INI:		
			LDI R16,0xFF

			LDI R16,HIGH(RAMEND)
			OUT SPH,R16
			LDI R16,LOW(RAMEND)
			OUT SPL,R16

			LDI R16,0xFF
			OUT DDRB,R16
			OUT PORTB,R16

			LDI R17,0x02
			OUT TIMSK,R17

			LDI R17,0x02
			OUT TIFR,R17

			LDI R17,0
			OUT TCNT0,R17

			LDI R17,156
			OUT OCR0,R17

			LDI R17,0x0B
			OUT TCCR0,R17

			CLR R16
			CLR R25
			CLR R20
			CLR R21
			CLR R22

			SEI

CHECK:		
			TST R25
			BRBS SREG_Z, CHECK

			DEC R25

FEMHZ:		INC R20
			CPI R20,10
			BRNE TOHZ

			CLR R20

			IN R16,PORTB
			LDI R17,64
			EOR R16,R17
			OUT PORTB,R16


TOHZ:		INC R21
			CPI R20,25
			BRNE ENHZ

			CLR R21

			IN R16,PORTB
			LDI R17,32
			EOR R16,R17
			OUT PORTB,R16


ENHZ:		INC R22
			CPI R22,50
			BRNE CHECK

			CLR R22

			IN R16,PORTB
			LDI R17,2
			EOR R16,R17
			OUT PORTB,R16


			RJMP CHECK


INT_0:		
			POP R16

			LDI R16,0x20
			OUT TIFR,R16

			INC R25

			PUSH R16
			RETI