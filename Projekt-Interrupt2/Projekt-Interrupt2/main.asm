.INCLUDE "M32ADEF.INC"

.ORG 0x0000
			RJMP SETUP

.ORG 0x0004
			RJMP INT_1 ;PORTD,3 (INT1)

.ORG 0x002A
; --------------------------------------- SETUP ---------------------------------------
SETUP:		
			;STACK POINTER
			LDI R16,HIGH(RAMEND)
			OUT SPH,R16
			LDI R16,LOW(RAMEND)
			OUT SPL,R16

			;KLARGØR BEN D3 TIL INTERRUPT INPUT
			CBI DDRD,3
			SBI PORTD,3

			;SLÅ BEN D5 OG D6 TIL OUTPUT. PÅ BENENE ER LED'ER, DER BRUGES SOM FEEDBACK, NÅR EN INTERRUPT REGISTRERES.
			SBI DDRD,5
			SBI DDRD,6

			;SLÅ INT1 TIL I FALLING-EDGE-MODE (DA DEN KUN SKAL AKTIVERES ÉN GANG, NÅR MAN F.EKS. KØRER OVER MÅLSTREGEN).
			LDI R16,0x80
			OUT GICR,R16
			LDI R17,0x08
			OUT MCUCR,R17

			SEI

;--------- MAIN FUNC -------
			;FØRST AKTIVERES DEN ENE LED. SOM STANDARD ER DEN ALTSÅ TÆNDT

LOOP:		;LOOP FOR AT TESTE, OM EN INTERRUPT ER REGISTRERET
			TST R24
			BRBS SREG_Z,LOOP

			DEC R24

			;HVIS EN INTERRUPT REGISTRERES, SLUKKES DEN ENE LED, OG DEN ANDEN TÆNDES.
			LDI R18,0x60
			IN R19,PORTD
			EOR R19,R18
			OUT PORTD,R19

			RJMP LOOP


;--------- INTERRUPT -------
INT_1:
			INC R24 ;FLAG TIL ANVENDELSE I "MAIN"
			RETI